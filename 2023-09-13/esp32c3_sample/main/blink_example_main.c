/* Blink Example

   This example code is in the Public Domain (or CC0 licensed, at your option.)

   Unless required by applicable law or agreed to in writing, this
   software is distributed on an "AS IS" BASIS, WITHOUT WARRANTIES OR
   CONDITIONS OF ANY KIND, either express or implied.
*/
#include <stdio.h>
#include <string.h>
#include "freertos/FreeRTOS.h"
#include "freertos/task.h"
#include "driver/gpio.h"
#include "esp_log.h"
#include "esp_timer.h"
#include "mbedtls/error.h"
#include "mbedtls/rsa.h"
#include "led_strip.h"
#include "sdkconfig.h"
#include "soc/dport_access.h"
#include "soc/hwcrypto_periph.h"
#include "bignum_impl.h"

static const char *TAG = "example";

/* Use project configuration menu (idf.py menuconfig) to choose the GPIO to blink,
   or you can edit the following line and set a number here.
*/
#define BLINK_GPIO CONFIG_BLINK_GPIO

static uint8_t s_led_state = 0;

#ifdef CONFIG_BLINK_LED_RMT

static led_strip_handle_t led_strip;

static void blink_led(void)
{
    /* If the addressable LED is enabled */
    if (s_led_state) {
        /* Set the LED pixel using RGB from 0 (0%) to 255 (100%) for each color */
        led_strip_set_pixel(led_strip, 0, 255, 255, 255);
        /* Refresh the strip to send data */
        led_strip_refresh(led_strip);
    } else {
        /* Set all LED off to clear all pixels */
        led_strip_clear(led_strip);
    }
}

static void configure_led(void)
{
    ESP_LOGI(TAG, "Example configured to blink addressable LED!");
    /* LED strip initialization with the GPIO and pixels number*/
    led_strip_config_t strip_config = {
        .strip_gpio_num = BLINK_GPIO,
        .max_leds = 1, // at least one LED on board
    };
    led_strip_rmt_config_t rmt_config = {
        .resolution_hz = 10 * 1000 * 1000, // 10MHz
    };
    ESP_ERROR_CHECK(led_strip_new_rmt_device(&strip_config, &rmt_config, &led_strip));
    /* Set all LED off to clear all pixels */
    led_strip_clear(led_strip);
}

#elif CONFIG_BLINK_LED_GPIO

static void blink_led(void)
{
    /* Set the GPIO level according to the state (LOW or HIGH)*/
    gpio_set_level(BLINK_GPIO, s_led_state);
}

static void configure_led(void)
{
    ESP_LOGI(TAG, "Example configured to blink GPIO LED!");
    gpio_reset_pin(BLINK_GPIO);
    /* Set the GPIO as a push/pull output */
    gpio_set_direction(BLINK_GPIO, GPIO_MODE_OUTPUT);
    gpio_set_direction(4, GPIO_MODE_OUTPUT);
    gpio_set_direction(5, GPIO_MODE_OUTPUT);
    gpio_set_level(4, 1);
    gpio_set_level(5, 1);
}

#endif

#ifdef RSA_4K_KEY
// https://github.com/openssl/openssl/blob/869d95b00e22b68897a541abf3bcee3589d2d519/crypto/rsa/rsa_ameth.c#L333-L344
static const unsigned char rsa_n[] = {
  0x00, 0xd7, 0x86, 0xf9, 0x2e, 0xff, 0xe3, 0xe2, 0x72, 0xf8, 0xa9, 0xb3,
  0x7e, 0x9c, 0x30, 0x9d, 0x5e, 0x0a, 0xbd, 0x99, 0xdb, 0x9d, 0x7a, 0xce,
  0xfc, 0x10, 0x46, 0x92, 0xa4, 0x9b, 0x3f, 0x8f, 0x13, 0x99, 0x41, 0xef,
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  0xfa, 0xa8, 0xd6, 0x27, 0x25, 0x7a, 0x4c, 0xb2, 0x43
};

static const unsigned char rsa_e[] = {
    0x01, 0x00, 0x01
};

static const unsigned char rsa_d[] = {
  0x52, 0xb6, 0x62, 0xe4, 0xed, 0xa1, 0x48, 0x23, 0x75, 0x58, 0xb3, 0x20,
  0xf0, 0xd2, 0x1b, 0x62, 0x9e, 0xde, 0x9a, 0xb0, 0x54, 0xa4, 0x6f, 0xd0,
  0xfe, 0x72, 0x07, 0x0f, 0x12, 0xe1, 0x76, 0x88, 0x3f, 0xf5, 0xb5, 0x04,
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  0x22, 0xc5, 0xf6, 0x78, 0xb8, 0xe9, 0x5b, 0x99
};

static const unsigned char rsa_p[] = {
  0x00, 0xdb, 0x71, 0x76, 0x0c, 0xa8, 0xb2, 0xef, 0x7c, 0x7d, 0x15, 0x9d,
  0xe1, 0x85, 0x50, 0xdd, 0xcf, 0x9b, 0xda, 0x5d, 0x04, 0x54, 0xfa, 0x4a,
  0x66, 0x47, 0xdc, 0xa4, 0x50, 0x7d, 0x6a, 0xea, 0xd9, 0x18, 0x0c, 0xc0,
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  0x47, 0x95, 0x14, 0x95, 0x6f
};

static const unsigned char rsa_q[] = {
  0x00, 0xfb, 0x6e, 0x82, 0x4a, 0xf3, 0x00, 0xd2, 0x6b, 0xaa, 0x16, 0xa0,
  0xb5, 0x83, 0xe5, 0x1a, 0xe2, 0xf1, 0x51, 0xec, 0x6a, 0x58, 0xc6, 0xc4,
  0x48, 0xe4, 0xe2, 0x92, 0x20, 0x32, 0xec, 0xf8, 0x70, 0x84, 0x02, 0xb4,
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  0xf2, 0x78, 0xf3, 0x0e, 0x6d
};

static const unsigned char rsa_dp[] = {
  0x00, 0xcb, 0xf9, 0x41, 0xe6, 0x70, 0x64, 0xaa, 0x90, 0xc7, 0x5f, 0xf1,
  0x79, 0xef, 0xc6, 0x83, 0xf6, 0xf7, 0x02, 0x59, 0x15, 0xae, 0xbb, 0x5b,
  0xae, 0x88, 0xbb, 0x81, 0x8c, 0x43, 0x97, 0xbf, 0x25, 0xfd, 0xe1, 0xd4,
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  0xc2, 0xe2, 0xc2, 0xd8, 0x47
};

static const unsigned char rsa_dq[] = {
  0x00, 0xbb, 0x12, 0x20, 0xdd, 0x14, 0xea, 0x62, 0xa4, 0xfa, 0x7b, 0x35,
  0x7d, 0x78, 0x31, 0xe9, 0x0c, 0x3b, 0x52, 0xa1, 0xdd, 0x0a, 0x4a, 0x71,
  0x56, 0x6e, 0xfd, 0xe8, 0x8d, 0x0e, 0x76, 0xe3, 0xee, 0x0b, 0x3a, 0x5c,
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  0xd6, 0x96, 0x88, 0xf9, 0x0d
};

static const unsigned char rsa_qp[] = {
  0x00, 0xb3, 0x5c, 0xa4, 0xd3, 0x79, 0x8e, 0x50, 0xb3, 0x61, 0xdf, 0xb5,
  0x15, 0xdb, 0xc8, 0xb4, 0x5d, 0xb1, 0x7b, 0xd3, 0x4f, 0xeb, 0x03, 0xeb,
  0x0f, 0x09, 0xe1, 0x97, 0x98, 0x1f, 0x59, 0xab, 0x47, 0x75, 0x24, 0x78,
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  0x90, 0x64, 0x39, 0x73, 0x03
};
#else
static const unsigned char rsa_n[] = {
  0x00, 0xa3, 0x85, 0xa3, 0x59, 0x7d, 0x1e, 0x5f, 0x25, 0xf9, 0x1b, 0x95,
  0x6b, 0x35, 0x95, 0x0e, 0x36, 0xbf, 0xc5, 0x3f, 0xe1, 0x6e, 0x0a, 0x09,
  0xfd, 0xf7, 0x99, 0xe8, 0xd6, 0x31, 0x71, 0x01, 0x01, 0x1a, 0x16, 0x15,
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  0x7c, 0x65, 0xbc, 0xeb, 0xa5, 0xe3, 0x59, 0x10, 0xb6, 0x0b, 0x23, 0x78,
  0x25
};

static const unsigned char rsa_e[] = {
    0x01, 0x00, 0x01
};

static const unsigned char rsa_d[] = {
  0x04, 0x28, 0xd3, 0xa9, 0x1a, 0x8e, 0x9b, 0x53, 0x84, 0xb0, 0x3b, 0x40,
  0x09, 0x19, 0x6a, 0x10, 0xb9, 0x67, 0x70, 0x70, 0x3b, 0x04, 0x71, 0x17,
  0xc8, 0x9d, 0xf1, 0xf2, 0x2a, 0x20, 0x6d, 0x02, 0x6e, 0x0f, 0x8c, 0x0f,
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  0x7c, 0xe4, 0x05, 0xaa, 0xeb, 0x65, 0x3f, 0x2d, 0x7d, 0xbe, 0x84, 0x29
};

static const unsigned char rsa_p[] = {
  0x00, 0xe2, 0xcc, 0x3b, 0xe2, 0x84, 0xd9, 0xf5, 0x2d, 0x99, 0x09, 0x13,
  0xd9, 0x61, 0xef, 0x41, 0x8c, 0x53, 0xaf, 0x55, 0x4c, 0x6d, 0x6c, 0x11,
  0x8b, 0x72, 0x80, 0x2b, 0x82, 0x35, 0x22, 0x75, 0x36, 0xa5, 0x7e, 0x7a,
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  0xa8, 0xa7, 0x5d, 0x27, 0x4b, 0x68, 0x63, 0x42, 0x3a, 0xe9, 0xa1, 0x5d,
  0xb3
};

static const unsigned char rsa_q[] = {
  0x00, 0xb8, 0x93, 0xb1, 0x40, 0x6e, 0xba, 0x57, 0x1a, 0x3f, 0x65, 0x6e,
  0x1c, 0xe8, 0x67, 0xf0, 0xb9, 0x02, 0x61, 0xd8, 0x0a, 0x4f, 0x11, 0x86,
  0x35, 0xae, 0x70, 0x87, 0x2e, 0xff, 0xe8, 0xd8, 0x5d, 0x7d, 0xec, 0x8d,
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  0x25, 0x63, 0xd4, 0x85, 0x01, 0x44, 0x0e, 0x39, 0x64, 0xdc, 0x20, 0xd6,
  0xc7
};

static const unsigned char rsa_dp[] = {
  0x04, 0xa9, 0x53, 0xf5, 0xc4, 0xeb, 0x41, 0xe9, 0xcd, 0x02, 0x6d, 0xc1,
  0x03, 0x0d, 0x4a, 0xd8, 0x9a, 0x83, 0xb9, 0x0a, 0x18, 0x19, 0xa7, 0x86,
  0xa9, 0x34, 0xcf, 0x30, 0x1e, 0xed, 0x75, 0x61, 0x49, 0x27, 0x7f, 0x57,
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  0xf0, 0x22, 0xaf, 0x03, 0x12, 0xc3, 0x2f, 0x82, 0x4c, 0x78, 0xff, 0x97
};

static const unsigned char rsa_dq[] = {
  0x4c, 0xd9, 0x01, 0x15, 0x88, 0x84, 0x80, 0xbb, 0x66, 0xe5, 0xbe, 0x20,
  0xbf, 0x0a, 0x77, 0x89, 0x2f, 0xda, 0xb8, 0xee, 0x21, 0xd9, 0x73, 0xfd,
  0x69, 0xb1, 0x64, 0x37, 0x47, 0x49, 0x14, 0xbc, 0x68, 0x2f, 0x52, 0xfa,
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  0x28, 0xae, 0x54, 0xea, 0x20, 0x01, 0xa4, 0x17, 0xc0, 0x26, 0xd4, 0x05
};

static const unsigned char rsa_qp[] = {
  0x00, 0xd9, 0xa6, 0x79, 0xa1, 0x55, 0x81, 0xfb, 0xd1, 0x5b, 0xf3, 0x83,
  0x58, 0x10, 0xbe, 0x33, 0x14, 0x43, 0xf8, 0x99, 0xa9, 0x58, 0xd2, 0xa7,
  0x3d, 0xb4, 0x99, 0x98, 0xf2, 0x3c, 0xca, 0xf7, 0xb3, 0x14, 0x86, 0x2b,
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  0xb2, 0x05, 0x8b, 0xd9, 0x8c, 0xd0, 0xa2, 0x39, 0x13, 0xf9, 0x95, 0xdd,
  0x58
};

#endif

static const unsigned char raw_X[] = {
    0x13, 0x77, 0x3b, 0x92, 0x11, 0x81, 0x6a, 0xba, 0x57, 0xeb, 0x4d, 0x30, 0x77, 0x90, 0xd1, 0x30, 
    0xc8, 0x75, 0xe4, 0x9e, 0x75, 0xeb, 0x20, 0x48, 0x9e, 0x7d, 0xe0, 0x2a, 0x8b, 0x69, 0x4f, 0xb8, 
    0xfc, 0x99, 0x0b, 0x4e, 0xeb, 0x2a, 0xe0, 0xaa, 0xc3, 0x75, 0x5e, 0xe5, 0x7e, 0x66, 0x66, 0x5f, 
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    0x8e, 0xe8, 0x4a, 0x7f, 0x3a, 0x38, 0x34, 0x1c, 0x9a, 0xf2, 0x98, 0x59, 0xaa, 0xc0, 0x7c, 0x1b
};
static const unsigned char raw_Y[] = {
    0x01, 0x00, 0x01
};
static const unsigned char raw_M[] = {
    0xa3, 0x85, 0xa3, 0x59, 0x7d, 0x1e, 0x5f, 0x25, 0xf9, 0x1b, 0x95, 0x6b, 0x35, 0x95, 0x0e, 0x36, 
    0xbf, 0xc5, 0x3f, 0xe1, 0x6e, 0x0a, 0x09, 0xfd, 0xf7, 0x99, 0xe8, 0xd6, 0x31, 0x71, 0x01, 0x01, 
    0x1a, 0x16, 0x15, 0x58, 0x21, 0x0b, 0xcc, 0xaa, 0xa0, 0xb2, 0x1f, 0x8e, 0xed, 0x74, 0xcc, 0x97, 
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    0x26, 0xd7, 0x04, 0x7c, 0x65, 0xbc, 0xeb, 0xa5, 0xe3, 0x59, 0x10, 0xb6, 0x0b, 0x23, 0x78, 0x25
};
static const unsigned char raw_Rinv[] = {
    0x47, 0xad, 0xbc, 0xb3, 0x04, 0xce, 0x4d, 0x60, 0x67, 0x05, 0xa4, 0xff, 0x6c, 0xfc, 0xd5, 0x21, 
    0x05, 0x09, 0x65, 0xf9, 0xfc, 0x18, 0x69, 0x64, 0x9b, 0x62, 0x67, 0x7f, 0xc4, 0x44, 0x56, 0x76, 
    0xfc, 0x9b, 0x7b, 0x49, 0x4f, 0xc7, 0xfd, 0xc1, 0xd9, 0x9e, 0xf0, 0xe9, 0xb4, 0x79, 0x1b, 0xcd, 
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    0x34, 0x89, 0xca, 0x81, 0x77, 0x80, 0x05, 0xdd, 0xb7, 0xad, 0xb4, 0xd7, 0xe3, 0xe7, 0xfe, 0x16
};
static const uint32_t Mprime = 2888571987;
static const size_t num_words = 96;

static const unsigned char raw_memblock_X[] = {
    0x1b, 0x7c, 0xc0, 0xaa, 0x59, 0x98, 0xf2, 0x9a, 0x1c, 0x34, 0x38, 0x3a, 0x7f, 0x4a, 0xe8, 0x8e, 
    0xe5, 0xcb, 0x34, 0x22, 0xf0, 0x44, 0xee, 0xd0, 0x56, 0x12, 0xc0, 0xb1, 0x51, 0xf0, 0xb7, 0xd2, 
    0x8d, 0x07, 0xd7, 0x4b, 0xed, 0x77, 0x1f, 0xbf, 0x75, 0xad, 0xa9, 0xf3, 0x28, 0x11, 0x6b, 0xc3, 
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    0x30, 0xd1, 0x90, 0x77, 0x30, 0x4d, 0xeb, 0x57, 0xba, 0x6a, 0x81, 0x11, 0x92, 0x3b, 0x77, 0x13, 
};
static const unsigned char raw_memblock_Y[] = {
    0x01, 0x00, 0x01, 0x00, 0x00, 0x00, 0x00, 0x00, 0x00, 0x00, 0x00, 0x00, 0x00, 0x00, 0x00, 0x00, 
    0x00, 0x00, 0x00, 0x00, 0x00, 0x00, 0x00, 0x00, 0x00, 0x00, 0x00, 0x00, 0x00, 0x00, 0x00, 0x00, 
    0x00, 0x00, 0x00, 0x00, 0x00, 0x00, 0x00, 0x00, 0x00, 0x00, 0x00, 0x00, 0x00, 0x00, 0x00, 0x00, 
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    0x00, 0x00, 0x00, 0x00, 0x00, 0x00, 0x00, 0x00, 0x00, 0x00, 0x00, 0x00, 0x00, 0x00, 0x00, 0x00, 
};
static const unsigned char raw_memblock_M[] = {
    0x25, 0x78, 0x23, 0x0b, 0xb6, 0x10, 0x59, 0xe3, 0xa5, 0xeb, 0xbc, 0x65, 0x7c, 0x04, 0xd7, 0x26, 
    0x18, 0x84, 0xf1, 0x19, 0x8a, 0xc5, 0x2b, 0x51, 0x16, 0xb7, 0xa2, 0xea, 0x10, 0x2d, 0x00, 0x8a, 
    0xc5, 0xf8, 0x7e, 0x9a, 0x7b, 0xfb, 0x5d, 0xd6, 0xb3, 0xb3, 0x4d, 0xaa, 0x03, 0x69, 0x20, 0x84, 
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    0x36, 0x0e, 0x95, 0x35, 0x6b, 0x95, 0x1b, 0xf9, 0x25, 0x5f, 0x1e, 0x7d, 0x59, 0xa3, 0x85, 0xa3, 
};
static const unsigned char raw_memblock_RB[] = {
    0x16, 0xfe, 0xe7, 0xe3, 0xd7, 0xb4, 0xad, 0xb7, 0xdd, 0x05, 0x80, 0x77, 0x81, 0xca, 0x89, 0x34, 
    0xa3, 0x51, 0x49, 0xb7, 0x95, 0x3b, 0xe5, 0xfa, 0x35, 0x8d, 0x2d, 0x73, 0x09, 0x6a, 0x86, 0x67, 
    0x6b, 0x2d, 0xe0, 0x1c, 0x2f, 0x3c, 0x17, 0xed, 0x1e, 0x2f, 0x15, 0x71, 0xc0, 0x83, 0x8a, 0xfa, 
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    0x21, 0xd5, 0xfc, 0x6c, 0xff, 0xa4, 0x05, 0x67, 0x60, 0x4d, 0xce, 0x04, 0xb3, 0xbc, 0xad, 0x47, 
};

// static inline void mem_block_to_mpi(mbedtls_mpi *x, uint32_t mem_base, size_t num_words)
// {
//     assert(x->MBEDTLS_PRIVATE(n) >= num_words);

//     /* Copy data from memory block registers */
//     esp_dport_access_read_buffer(x->MBEDTLS_PRIVATE(p), mem_base, num_words);

//     /* Zero any remaining limbs in the bignum, if the buffer is bigger
//        than num_words */
//     for (size_t i = num_words; i < x->MBEDTLS_PRIVATE(n); i++) {
//         x->MBEDTLS_PRIVATE(p[i]) = 0;
//     }
// }

static inline void raw_to_mem_block(uint32_t mem_base, const unsigned char *data, size_t hw_words)
{
    uint32_t copy_words = hw_words;

    /* Copy MPI data to memory block registers */
    for (uint32_t i = 0; i < copy_words; i++) {
        DPORT_REG_WRITE(mem_base + i * 4, (uint32_t)(data + (4 * i)));
    }

#if _INTERNAL_DEBUG_PURPOSE
    /*
     * With Xtensa GCC 11.2.0 (from ESP-IDF v5.x), it was observed that above zero initialization
     * loop gets optimized to `memset` call from the ROM library. This was causing an issue that
     * specific write (store) operation to the MPI peripheral block was getting lost erroneously.
     * Following data re-verify loop could catch it during runtime.
     *
     * As a workaround, we are using DPORT_WRITE_REG (volatile writes) wrappers to write to
     * the MPI peripheral.
     *
     */

    //for (uint32_t i = copy_words; i < hw_words; i++) { assert(pbase[i] == 0); }
#endif
}

/* Begin an RSA operation. op_reg specifies which 'START' register
   to write to.
*/
static inline void start_op(uint32_t op_reg)
{
    /* Clear interrupt status */
    DPORT_REG_WRITE(RSA_INTERRUPT_REG, 1);

    /* Note: above REG_WRITE includes a memw, so we know any writes
       to the memory blocks are also complete. */

    DPORT_REG_WRITE(op_reg, 1);
}

/* Wait for an RSA operation to complete.
*/
static inline void wait_op_complete(void)
{
    while (DPORT_REG_READ(RSA_INTERRUPT_REG) != 1)
    { }

    /* clear the interrupt */
    DPORT_REG_WRITE(RSA_INTERRUPT_REG, 1);
}

/* Read result from last MPI operation */
static void janis_esp_mpi_read_result_hw_op(mbedtls_mpi *Z, size_t z_words)
{
    wait_op_complete();
    //mem_block_to_mpi(Z, RSA_MEM_Z_BLOCK_BASE, z_words);
}

/* Z = (X ^ Y) mod M
*/
static void janis_esp_mpi_exp_mpi_mod_hw_op(mbedtls_mpi_uint Mprime, size_t _num_words)
{
    REG_WRITE(RSA_LENGTH_REG, (_num_words - 1));

    /* Load M, X, Rinv, Mprime (Mprime is mod 2^32) */
    raw_to_mem_block(RSA_MEM_X_BLOCK_BASE, raw_memblock_X, num_words);
    raw_to_mem_block(RSA_MEM_Y_BLOCK_BASE, raw_memblock_Y, num_words);
    raw_to_mem_block(RSA_MEM_M_BLOCK_BASE, raw_memblock_M, num_words);
    raw_to_mem_block(RSA_MEM_RB_BLOCK_BASE, raw_memblock_RB, num_words);
    REG_WRITE(RSA_M_DASH_REG, Mprime);

    /* Enable acceleration options */
    REG_WRITE(RSA_CONSTANT_TIME_REG, 0);
    REG_WRITE(RSA_SEARCH_ENABLE_REG, 0);
    REG_WRITE(RSA_SEARCH_POS_REG, (_num_words * 32) - 1);

    /* Execute first stage montgomery multiplication */
    start_op(RSA_MODEXP_START_REG);


    REG_WRITE(RSA_SEARCH_ENABLE_REG, 0);
}

static int myrand(void *rng_state, unsigned char *output, size_t len)
{
    size_t use_len;
    int rnd;

    if (rng_state != NULL) {
        rng_state  = NULL;
    }

    while (len > 0) {
        use_len = len;
        if (use_len > sizeof(int)) {
            use_len = sizeof(int);
        }

        rnd = rand();
        memcpy(output, &rnd, use_len);
        output += use_len;
        len -= use_len;
    }

    return 0;
}

int sign() {
    // openssl rsa -inform PEM -text -noout -in private_key.pem
    // then do some xxd-based magic

    struct mbedtls_rsa_context rsa_ctx;
    mbedtls_rsa_init(&rsa_ctx);
    // define rsa_keypair_t struct type
    struct rsa_keypair_t {
        uint8_t *n;
        size_t n_len;
        uint8_t *e;
        size_t e_len;
        uint8_t *d;
        size_t d_len;
        uint8_t *p;
        size_t p_len;
        uint8_t *q;
        size_t q_len;
        uint8_t *dp;
        size_t dp_len;
        uint8_t *dq;
        size_t dq_len;
        uint8_t *qp;
        size_t qp_len;
    };

    // init rsa_keypair
    struct rsa_keypair_t rsa_keypair = {
        .n = (uint8_t *)rsa_n,
        .n_len = sizeof(rsa_n),
        .e = (uint8_t *)rsa_e,
        .e_len = sizeof(rsa_e),
        .d = (uint8_t *)rsa_d,
        .d_len = sizeof(rsa_d),
        .p = (uint8_t *)rsa_p,
        .p_len = sizeof(rsa_p),
        .q = (uint8_t *)rsa_q,
        .q_len = sizeof(rsa_q),
        .dp = (uint8_t *)rsa_dp,
        .dp_len = sizeof(rsa_dp),
        .dq = (uint8_t *)rsa_dq,
        .dq_len = sizeof(rsa_dq),
        .qp = (uint8_t *)rsa_qp,
        .qp_len = sizeof(rsa_qp),
    };
    // import rsa private key
    mbedtls_rsa_import_raw(&rsa_ctx, rsa_keypair.n, rsa_keypair.n_len, rsa_keypair.p, rsa_keypair.p_len, rsa_keypair.q, rsa_keypair.q_len, rsa_keypair.d, rsa_keypair.d_len, rsa_keypair.e, rsa_keypair.e_len);
    mbedtls_rsa_complete(&rsa_ctx);
    // check public key
    if (mbedtls_rsa_check_pubkey(&rsa_ctx) != 0) {
        ESP_LOGE(TAG, "mbedtls_rsa_check_pubkey failed");
        return -1;
    }
    // check private key
    if (mbedtls_rsa_check_privkey(&rsa_ctx) != 0) {
        ESP_LOGE(TAG, "mbedtls_rsa_check_privkey failed");
        return -1;
    }
    uint8_t *input = malloc(mbedtls_rsa_get_len(&rsa_ctx));
    uint8_t *output = malloc(mbedtls_rsa_get_len(&rsa_ctx));
    memset(input, 0x01, mbedtls_rsa_get_len(&rsa_ctx));
    input[mbedtls_rsa_get_len(&rsa_ctx) / 2] = 0x01;
    memset(output, 0x00, mbedtls_rsa_get_len(&rsa_ctx));
    {
        ESP_LOGI(TAG, "sign start");
        // get start time
        uint64_t start = esp_timer_get_time();
        const int repeat = 0;
        uint64_t *delta_time = malloc(repeat * sizeof(uint64_t));
        for (int i = 0; i < repeat; i++) {
            int result = mbedtls_rsa_private(&rsa_ctx, myrand, NULL, input, output);
            if (result != 0) {
                char buf[1024];
                mbedtls_strerror(result, buf, sizeof(buf));
                //ESP_LOGE(TAG, "mbedtls_rsa_private[%d] failed with 0x%x - %s", i, -result, buf);
            }
            // get end time
            uint64_t end = esp_timer_get_time();
            // calculate time delta
            uint64_t delta = end - start;
            delta_time[i] = delta;
            // get time for current iteration
            uint64_t delta_iter = delta - (i > 0 ? delta_time[i - 1] : 0);
            // convert time delta to milliseconds
            // log time taken
            //ESP_LOGI(TAG, "sign %d took %llu ms, %llu us per iteration", i, delta, delta_iter);
        }
        free(delta_time);
        // get end time
        uint64_t end = esp_timer_get_time();
        // calculate time delta
        uint64_t delta = end - start;
        // convert time delta to milliseconds
        double delta_ms = (double)delta / 1000;
        // log time taken
        if (repeat != 0) {
            ESP_LOGI(TAG, "sign took %f ms, %f ms per iteration", delta_ms, delta_ms / repeat);
        }
    }
    free(input);
    free(output);
    mbedtls_rsa_free(&rsa_ctx);

    (void)raw_X;
    (void)raw_Y;
    (void)raw_M;
    (void)raw_Rinv;
    (void)num_words;
    (void)Mprime;
#if CONFIG_MBEDTLS_HARDWARE_MPI
    {
        uint64_t start = esp_timer_get_time();

        esp_mpi_enable_hardware_hw_op();
        const int repeat = 5;
        // do the math
        // Z = (X ^ Y) mod M
        for (int i = 0; i < repeat; i++) {
            janis_esp_mpi_exp_mpi_mod_hw_op(Mprime, num_words);
            wait_op_complete();
        }
        esp_mpi_disable_hardware_hw_op();

        uint64_t end = esp_timer_get_time();
        // calculate time delta
        uint64_t delta = end - start;
        // convert time delta to milliseconds
        double delta_ms = (double)delta / 1000;
        // log time taken
        if (repeat != 0) {
            ESP_LOGI(TAG, "exp took %f ms, %f ms per iteration", delta_ms, delta_ms / repeat);
        }
    }
#endif
    return 0;
}

void app_main(void)
{

    /* Configure the peripheral according to the LED type */
    configure_led();

    while (1) {
        //ESP_LOGI(TAG, "Turning the LED %s!", s_led_state == true ? "ON" : "OFF");
        blink_led();
        sign();
        /* Toggle the LED state */
        s_led_state = !s_led_state;
        vTaskDelay(CONFIG_BLINK_PERIOD / portTICK_PERIOD_MS);
    }
}

